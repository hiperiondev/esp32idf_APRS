## components/esp_telegram_bot/Kconfig
```kconfig
menu "Telegram bot transport"

    config TELEGRAM_BOT_CERT_BUNDLE
        bool "Validate api.telegram.org against the ESP-IDF certificate bundle"
        default n
        select MBEDTLS_CERTIFICATE_BUNDLE
        help
            When enabled, the TLS connection to api.telegram.org is validated
            against the certificate bundle shipped with ESP-IDF, which keeps
            working when Telegram rotates its certificate chain.

            It is also what covers a host answered by several front-ends,
            each presenting a chain rooted at a different authority.

            When disabled, the trusted roots are read at run time from a PEM
            file stored in the LittleFS storage partition. That file can be
            replaced from the web admin's File Storage page whenever the
            server chain changes, without rebuilding the firmware, but it
            only trusts the authorities it actually carries.

    config TELEGRAM_BOT_CERT_PATH
        string "Path of the root certificate file"
        depends on !TELEGRAM_BOT_CERT_BUNDLE
        default "/storage/telegram_certificate.pem"
        help
            Absolute path of the PEM file holding the trusted roots of
            api.telegram.org. It must sit inside STORAGE_BASE_PATH, the
            mount point of the LittleFS partition brought up by
            main/storage.c, and it is read once, when telegram_bot_init()
            runs, so the file system has to be mounted first.

            Several certificates may be concatenated in the file and each
            becomes a trust anchor. api.telegram.org is answered by more
            than one front-end and they do not all chain to the same
            authority, so a file carrying a single root validates only the
            connections that land on a matching front-end and fails the
            others with mbedTLS error -0x2700. The count actually loaded is
            logged at start-up.

    config TELEGRAM_BOT_CERT_MAX_LEN
        int "Largest accepted certificate file"
        depends on !TELEGRAM_BOT_CERT_BUNDLE
        range 512 16384
        default 8192
        help
            Size in bytes above which the certificate file is rejected
            instead of being loaded. It bounds the heap the transport
            holds for the whole life of the connection, and therefore how
            many roots the file may concatenate: a PEM root runs to roughly
            1.5 kB, so the default leaves room for a handful.

endmenu
```

## components/sensors_local/Kconfig
```kconfig
menu "Sensors Local"

    config SENSORS_LOCAL_WEATHER_EXAMPLE_DRIVER
        bool "Enable example WEATHER local sensor driver (random values, no hardware)"
        default n
        help
            Registers a fake weather sensor ("wx-example") that feeds random
            wind/temperature/humidity/pressure/rain/luminosity readings into
            the pipeline. Useful to exercise the Weather page's channel
            picker and the WX beacon encoder with no hardware attached.

            Off by default: real weather drivers (BME280, BMP180) exist, and
            these values are indistinguishable from real readings once an
            operator maps them to a Weather channel - they will be encoded
            into a WX beacon and transmitted on air. Only turn this on for
            bench testing, and turn it off again before keying a radio.

    config SENSORS_LOCAL_TELEMETRY_EXAMPLE_DRIVER
        bool "Enable example TELEMETRY local sensor driver (random values, no hardware)"
        default n
        help
            Registers a fake telemetry sensor ("tlm-example") that feeds
            random analog/digital channel values into the pipeline. Useful
            to exercise the Telemetry page's channel picker with no
            hardware attached.

            Off by default: once an operator maps one of these channels and
            enables telemetry transmission, the random values are encoded
            into telemetry beacons and sent on air, where they are
            indistinguishable from real measurements. Only turn this on for
            bench testing, and turn it off again before keying a radio.

    config SENSORS_LOCAL_BME280_DRIVER
        bool "Enable BME280 I2C WEATHER sensor driver (temperature + humidity + pressure)"
        default y
        help
            Registers a real weather sensor ("bme280") for the Bosch BME280
            digital humidity / barometric-pressure / temperature sensor over
            I2C. The slave address and the measurement settings are fixed at
            build time in BME280.h; the SDA/SCL pins are shared by every
            local sensor and come from sensors_local_i2c.h (default
            GPIO21 = SDA, GPIO22 = SCL). Those pins are excluded from every
            GPIO picker in the web admin so they cannot be reassigned to
            another peripheral. Requires the esp-idf-lib/bmp280 managed
            component, which is named after the BMP280 and drives the BME280
            as well.

            This is the default real weather sensor. It also drives the
            BMP280, the register-compatible part without the humidity
            element: the chip ID is read at bring-up, and a board carrying
            that part reports Temperature and Pressure only, with no
            Humidity source offered on the Weather page's channel picker.

    config SENSORS_LOCAL_BMP180_DRIVER
        bool "Enable BMP180 I2C WEATHER sensor driver (temperature + pressure)"
        default n
        help
            Registers a real weather sensor ("bmp180") for the Bosch BMP180
            digital barometric-pressure / temperature sensor over I2C, the
            older predecessor of the BMP280. It shares the same bus pins as
            every other local sensor (sensors_local_i2c.h), so both may be
            enabled at once: each chip answers on its own slave address.
            Requires the esp-idf-lib/bmp180 managed component.

            Off by default: turn it on only for a board actually fitted with
            a BMP180.

endmenu
```

## components/telegram_service/Kconfig
```kconfig
menu "Telegram bot service"

    config TELEGRAM_SERVICE_MAX_USERS
        int "Maximum number of authorized users"
        range 1 64
        default 8
        help
            Size of the static table holding the users allowed to interact
            with the bot.

    config TELEGRAM_SERVICE_MAX_CHATS
        int "Maximum number of allowed group chats"
        range 1 32
        default 4
        help
            Size of the static table holding the group chats the bot serves.

    config TELEGRAM_SERVICE_MAX_COMMANDS
        int "Maximum number of registered commands"
        range 16 64
        default 20
        help
            Size of the static command table. The fourteen built-in
            commands are registered in this same table, so anything below
            fifteen leaves no room for a command of your own and anything
            below fourteen makes telegram_init() fail outright. The lower
            bound of this range is set accordingly; the default leaves six
            free slots.

    config TELEGRAM_SERVICE_MAX_CALLBACKS
        int "Maximum number of inline button handlers"
        range 1 32
        default 4
        help
            Size of the static table routing inline button payloads to
            handlers by prefix. The built-in /menu command registers its
            own, so leave room for it; raise this to match the number of
            button prefixes the application adds on top.

    config TELEGRAM_SERVICE_MAX_PARAMS
        int "Maximum number of remotely configurable parameters"
        range 1 32
        default 4
        help
            Size of the static table holding the parameters exposed through
            the /config, /get and /set commands. Raise it to match the
            number of parameters the application actually registers.

    config TELEGRAM_SERVICE_MAX_SENSORS
        int "Maximum number of published sensors"
        range 1 32
        default 4
        help
            Size of the static table holding the sensors exposed through the
            /sensors and /status commands. Raise it to match the number of
            sensors the application actually publishes.

    config TELEGRAM_SERVICE_RX_BUFFER_SIZE
        int "Default size of the update reception buffer"
        range 1024 32768
        default 2048
        help
            Default capacity of the buffer holding one getUpdates answer.
            An answer larger than this is skipped and reported, so the
            default trades a rare long batch for heap that a TLS handshake
            needs in one contiguous piece. Increase it when updates carry
            long texts, when several updates are delivered in a single
            batch, or on a board with memory to spare.

    config TELEGRAM_SERVICE_TASK_STACK_SIZE
        int "Default stack size of the service task"
        range 4096 32768
        default 8192
        help
            Default stack size in bytes of the task created by
            telegram_start(). TLS and JSON parsing dominate this figure.

endmenu
```
